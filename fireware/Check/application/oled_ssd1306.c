#include "oled_ssd1306.h"

#include "Com_debug.h"
#include "i2c.h"
#include "string.h"
#include "cmsis_os.h"

/* 外部定义的 I2C 互斥信号量（在 freertos.c 中创建） */
extern osSemaphoreId_t mutex_i2cHandle;

/* 当 I2C 总线连续写失败时，尝试对 I2C 外设软复位以恢复 */
static void Oled_I2C_Reset(void)
{
  (void)HAL_I2C_DeInit(&hi2c1);
  HAL_Delay(5);
  if (HAL_I2C_Init(&hi2c1) != HAL_OK) {
    /* re-init failed - nothing more to do here */
  } else {
    /* re-init ok */
  }
}

#define OLED_I2C_ADDR                     (0x3CU << 1U)
#define OLED_CONTROL_CMD                  0x00U
#define OLED_CONTROL_DATA                 0x40U
#define OLED_PAGE_COUNT                   8U
#define OLED_FONT_WIDTH                   6U
#define OLED_FONT_HEIGHT                  8U

/* 使用最小 5x7 ASCII 字库，优先保证 0.96 寸 OLED 可直接显示业务信息。 */
static uint8_t oled_buffer[OLED_WIDTH * OLED_PAGE_COUNT];

/* 清空显示缓冲区并保留显示器刷新操作由调用者控制 */
void Oled_Clear(void)
{
  memset(oled_buffer, 0, sizeof(oled_buffer));
}

static const uint8_t oled_font_5x7[][5] = {
  {0x00,0x00,0x00,0x00,0x00},{0x00,0x00,0x5F,0x00,0x00},{0x00,0x07,0x00,0x07,0x00},{0x14,0x7F,0x14,0x7F,0x14},
  {0x24,0x2A,0x7F,0x2A,0x12},{0x23,0x13,0x08,0x64,0x62},{0x36,0x49,0x55,0x22,0x50},{0x00,0x05,0x03,0x00,0x00},
  {0x00,0x1C,0x22,0x41,0x00},{0x00,0x41,0x22,0x1C,0x00},{0x14,0x08,0x3E,0x08,0x14},{0x08,0x08,0x3E,0x08,0x08},
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  {0x00,0x00,0x7F,0x00,0x00},{0x00,0x41,0x36,0x08,0x00},{0x08,0x04,0x08,0x10,0x08},{0x00,0x00,0x00,0x00,0x00}
};
static void Oled_UpdateScreen_NoLock(void);
static void Oled_WriteCommand(uint8_t cmd)
{
  uint8_t packet[2] = {OLED_CONTROL_CMD, cmd};
  int ret = HAL_OK;
  int attempt;
  for (attempt = 0; attempt < 5; attempt++) {
    ret = HAL_I2C_Master_Transmit(&hi2c1, OLED_I2C_ADDR, packet, sizeof(packet), 100U);
    if (ret == HAL_OK) break;
    if (ret == HAL_BUSY) {
      HAL_Delay(1);
      continue;
    }
    HAL_Delay(1);
  }

  if (ret != HAL_OK) {
    /* 如果多次重试仍失败，尝试软复位 I2C 再重试一次 */
    Oled_I2C_Reset();
    ret = HAL_I2C_Master_Transmit(&hi2c1, OLED_I2C_ADDR, packet, sizeof(packet), 100U);
    if (ret != HAL_OK) {
      /* final command write failed */
    } else {
      /* final command write succeeded */
    }
  }
}

static void Oled_WriteData(const uint8_t *data, uint16_t size)
{
  uint8_t packet[17];
  uint16_t offset = 0U;
  uint8_t chunk;

  packet[0] = OLED_CONTROL_DATA;
  /* SSD1306 I2C 一次不宜发太大块，按小块拆分更稳妥。 */
  while (offset < size)
  {
    chunk = (uint8_t)((size - offset) > 16U ? 16U : (size - offset));
    memcpy(&packet[1], &data[offset], chunk);
    int ret = HAL_OK;
    int attempt;
    /* 重试策略：遇到 BUSY 则短等待后重试，避免与同时发生的外设操作冲突 */
    for (attempt = 0; attempt < 5; attempt++) {
      ret = HAL_I2C_Master_Transmit(&hi2c1, OLED_I2C_ADDR, packet, (uint16_t)(chunk + 1U), 100U);
      if (ret == HAL_OK) break;
      if (ret == HAL_BUSY) {
        HAL_Delay(2);
        continue;
      }
      HAL_Delay(2);
    }
    if (ret != HAL_OK) {
      Oled_I2C_Reset();
      ret = HAL_I2C_Master_Transmit(&hi2c1, OLED_I2C_ADDR, packet, (uint16_t)(chunk + 1U), 100U);
      if (ret != HAL_OK) {
        /* final transmit failed */
      } else {
        /* final transmit succeeded */
      }
    }
    offset += chunk;
  }
}

/* 可由外部触发的重初始化标志（DisplayTask 将在安全上下文中执行重初始化） */
static volatile uint8_t g_oled_reinit_request = 0U;

void Oled_TriggerReinit(void)
{
  g_oled_reinit_request = 1U;
}

uint8_t Oled_ConsumeReinitRequest(void)
{
  if (g_oled_reinit_request != 0U) {
    g_oled_reinit_request = 0U;
    return 1U;
  }
  return 0U;
}

void Oled_Init(void)
{
  HAL_Delay(100U);
  /* If RTOS mutex is not yet created (early init before scheduler), perform init without mutex. */
  int have_mutex = 0;
  if (mutex_i2cHandle != NULL && osSemaphoreAcquire(mutex_i2cHandle, pdMS_TO_TICKS(200)) == osOK) {
    have_mutex = 1;
  }

  Oled_WriteCommand(0xAEU);
  Oled_WriteCommand(0x20U);
  Oled_WriteCommand(0x10U);
  Oled_WriteCommand(0xB0U);
  Oled_WriteCommand(0xC8U);
  Oled_WriteCommand(0x00U);
  Oled_WriteCommand(0x10U);
  Oled_WriteCommand(0x40U);
  Oled_WriteCommand(0x81U);
  Oled_WriteCommand(0x7FU);
  Oled_WriteCommand(0xA1U);
  Oled_WriteCommand(0xA6U);
  Oled_WriteCommand(0xA8U);
  Oled_WriteCommand(0x3FU);
  Oled_WriteCommand(0xA4U);
  Oled_WriteCommand(0xD3U);
  Oled_WriteCommand(0x00U);
  Oled_WriteCommand(0xD5U);
  Oled_WriteCommand(0x80U);
  Oled_WriteCommand(0xD9U);
  Oled_WriteCommand(0xF1U);
  Oled_WriteCommand(0xDAU);
  Oled_WriteCommand(0x12U);
  Oled_WriteCommand(0xDBU);
  Oled_WriteCommand(0x20U);
  Oled_WriteCommand(0x8DU);
  Oled_WriteCommand(0x14U);
  Oled_WriteCommand(0xAFU);
  Oled_Clear();

  /* 已获取互斥则在互斥下刷新；否则直接无锁刷新（初始化阶段） */
  if (have_mutex) {
    Oled_UpdateScreen_NoLock();
    osSemaphoreRelease(mutex_i2cHandle);
  } else {
    Oled_UpdateScreen_NoLock();
  }

  memset(oled_buffer, 0, sizeof(oled_buffer));
}

void Oled_UpdateScreen(void)
{
  uint8_t page;

  /* SSD1306 以页为单位刷新，每页 8 行像素。 */
  /* 由上层获取互斥再调用或自行获取后调用内部刷新函数 */
  if (mutex_i2cHandle == NULL || osSemaphoreAcquire(mutex_i2cHandle, pdMS_TO_TICKS(200)) != osOK) {
    /* failed to acquire mutex */
    return;
  }

  for (page = 0U; page < OLED_PAGE_COUNT; page++)
  {
    Oled_WriteCommand((uint8_t)(0xB0U + page));
    Oled_WriteCommand(0x00U);
    Oled_WriteCommand(0x10U);
    Oled_WriteData(&oled_buffer[OLED_WIDTH * page], OLED_WIDTH);
    HAL_Delay(1);
  }

  osSemaphoreRelease(mutex_i2cHandle);
}

/* 内部不加锁的刷新实现（假定调用者已持有互斥） */
static void Oled_UpdateScreen_NoLock(void)
{
  uint8_t page;

  for (page = 0U; page < OLED_PAGE_COUNT; page++)
  {
    Oled_WriteCommand((uint8_t)(0xB0U + page));
    Oled_WriteCommand(0x00U);
    Oled_WriteCommand(0x10U);
    Oled_WriteData(&oled_buffer[OLED_WIDTH * page], OLED_WIDTH);
    HAL_Delay(1);
  }
}

void Oled_DrawChar(uint8_t x, uint8_t y, char ch)
{
  uint8_t idx;
  uint8_t glyph;
  uint16_t buf_index;
  uint8_t font_index;

  if (x >= (OLED_WIDTH - OLED_FONT_WIDTH) || y >= OLED_PAGE_COUNT)
  {
    return;
  }

  font_index = ((uint8_t)ch < 32U || (uint8_t)ch > 127U) ? 95U : (uint8_t)ch - 32U;
  for (idx = 0U; idx < 5U; idx++)
  {
    glyph = oled_font_5x7[font_index][idx];
    buf_index = (uint16_t)(y * OLED_WIDTH) + x + idx;
    oled_buffer[buf_index] = glyph;
  }
  oled_buffer[(y * OLED_WIDTH) + x + 5U] = 0x00U;
}

void Oled_DrawString(uint8_t x, uint8_t y, const char *text)
{
  uint8_t cursor_x = x;

  if (text == NULL)
  {
    return;
  }

  while ((*text != '\0') && (cursor_x < (OLED_WIDTH - OLED_FONT_WIDTH)))
  {
    Oled_DrawChar(cursor_x, y, *text);
    cursor_x = (uint8_t)(cursor_x + OLED_FONT_WIDTH);
    text++;
  }
}

void Oled_RenderDisplayModel(const AttendanceDisplayModelTypeDef *display)
{
  if (display == NULL)
  {
    return;
  }
  /* render model to buffer */

  /* 当前显示模型固定映射到四行文本，后续可继续扩展图标/进度条。 */
  Oled_Clear();
  Oled_DrawString(0U, 0U, display->line1);
  Oled_DrawString(0U, 2U, display->line2);
  Oled_DrawString(0U, 4U, display->line3);
  Oled_DrawString(0U, 6U, display->line4);
  Oled_UpdateScreen();
}